## package/python-pillow/Config.in
```kconfig
config BR2_PACKAGE_PYTHON_PILLOW
	bool "python-pillow"
	select BR2_PACKAGE_PYTHON3_PYEXPAT # runtime
	select BR2_PACKAGE_PYTHON3_ZLIB
	select BR2_PACKAGE_LIBRAQM
	help
	  Pillow is the "friendly" PIL fork by Alex Clark and
	  Contributors. PIL is the Python Imaging Library by Fredrik
	  Lundh and Contributors.

	  Pillow relies on external libraries to provide support
	  various image formats. Select the corresponding package(s)
	  to get this support. Pillow can use jpeg, zlib (for PNG),
	  tiff, freetype, webp, openjpeg (JPEG-2000), and libraqm
	  (for complex text layout).

	  https://pypi.python.org/pypi/Pillow/
```
